#include "st7565r.h"
#include <msp430.h>
//#include "io.h"
//#include "hzconf.h"

unsigned char border_inf[8] = {0x00,0x00,0x00,0x80,0x01,0x00,0x00,0x00 };
unsigned char const corp_pic[] = {
/*--  调入了一幅图像：E:\2008设计项目\Test Programs\lcm_取模图片\12864（福瑞博）.bmp  --*/
/*--  宽度x高度=128x64  --*/
0xFF,0x00,0x00,0x00,0x00,0x00,0x00,0x00,0x00,0x00,0x00,0x00,0x00,0x00,0x00,0x00,
0x00,0x00,0x00,0x00,0x00,0x00,0x00,0x00,0x00,0x00,0x00,0x00,0x00,0x00,0x00,0x00,
0x00,0x00,0x00,0x00,0x00,0x00,0x00,0x00,0x00,0x00,0x00,0x00,0x00,0x00,0x00,0x00,
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0x00,0x00,0x01,0x00,0x00,0x00,0x00,0x00,0x00,0x00,0x00,0x00,0x00,0x00,0x00,0xFF,

};





void Delayus(unsigned int us)
{
	unsigned int i=0;
    while(us--)   for( i=0;i<450;i++);
}

/*
 * 向lcd写入一个字节
 * byte：写入的字节
 * cmd:
 *     1:写入命令
 *     0：写入data
 * */
void Lcd_Byte_Wr(unsigned char byte,unsigned char cmd)
{
	 unsigned char k;

	CSB_LOW;
	if(cmd)   A0_LOW;
	else  A0_HIGH;

	 for (k=0; k<8; k++)
	 {
		 SCL_LOW;
		 if( byte&0x80 )  SDA_HIGH;
		 else SDA_LOW;
		 SCL_HIGH;
		 byte = byte<<1;
	 }

	CSB_HIGH;
}



/*LCD_INit
 * 初始化LCD，
 * */
unsigned char Lcd_Init(void)
{
	/*io口设置   CSB--P1.0,RESEB--P1.1,A0--P1.2,SCLK--P3.0,SDA--P3,1 */
	P1DIR |=BIT0+BIT1+BIT2+BIT3+BIT4;
	//P3DIR |=BIT0+BIT1;

	RESEB_LOW;
	Delayus(100);
	RESEB_HIGH;
        //WDTCTL = WDT_ARST_250;;
	Lcd_Byte_Wr(0xe2,1);  //reset
	Delayus(100);
	Lcd_Byte_Wr(0xa2,1);  // 1/6 bias
	Lcd_Byte_Wr(0xa0,1);  // mx=0,normal direction
	Lcd_Byte_Wr(0xc0,1); //COM my=0,正向扫描
	Lcd_Byte_Wr(0xa6,1);  //正向显示

	Lcd_Byte_Wr(0x81,1);  //对比度设置，数值越大对比度越低
	Lcd_Byte_Wr(0x07,1);

	Lcd_Byte_Wr(0x26,1);  //稳压电阻率设置。高5位为命令码，低3位为设置数据。
	Delayus(100);
        //WDTCTL = WDT_ARST_250;;
	Lcd_Byte_Wr(0x2f,1);  //buitl in booster on,build in regulator on，built in followr on
	Delayus(100);

	Lcd_Byte_Wr(0xf8,1);  //booster level set
	Lcd_Byte_Wr(0x00,1);


	Lcd_Byte_Wr(0xaf,1);   //显示打开
 
        
        return 1;
}



void disp_border(void)
{
	unsigned int page_cnt,col_cnt;
	unsigned char pg_address;

	pg_address = 0xB0;

	for (page_cnt=0;page_cnt<8;page_cnt++)
	{
	
		Lcd_Byte_Wr(pg_address,1); 


		Lcd_Byte_Wr(0x10,1);

	
		Lcd_Byte_Wr(0x01,1);

		Lcd_Byte_Wr(0xFF,0);
		
		for (col_cnt=0;col_cnt<126;col_cnt++)
		{
			Lcd_Byte_Wr(border_inf[page_cnt],0);
		}

		Lcd_Byte_Wr(0xFF,0);

		pg_address ++;
	
	}
	Delayus(1000);
        
        //disp_bmp(corp_pic);
}



void disp_dat(unsigned char uc_dat1,unsigned char uc_dat2,unsigned int Is_Twice)
{
	unsigned int page_cnt,col_cnt;
	unsigned char pg_address;

	pg_address = 0xB0;

	for (page_cnt=0;page_cnt<8;page_cnt++)
	{
	
		Lcd_Byte_Wr(pg_address,1); 

	
		Lcd_Byte_Wr(0x10,1);


		Lcd_Byte_Wr(0x01,1);
		for (col_cnt=0;col_cnt<32;col_cnt++)
		{
			if (Is_Twice == 0)
			{
				Lcd_Byte_Wr(uc_dat1,0);	//   delayms();
				Lcd_Byte_Wr(uc_dat2,0);	//  delayms();
				Lcd_Byte_Wr(uc_dat1,0);	//  delayms();
				Lcd_Byte_Wr(uc_dat2,0);	//  delayms();//delayms();delayms();
			}
			else
			{
				Lcd_Byte_Wr(uc_dat1,0);
				Lcd_Byte_Wr(uc_dat1,0);
				Lcd_Byte_Wr(uc_dat2,0);
				Lcd_Byte_Wr(uc_dat2,0);
			}
		}
			 //delayms();delayms();
		pg_address ++;
	}
	Delayus(10);
}

void disp_bmp(void)
{
	unsigned int page_cnt,col_cnt;
	unsigned char pg_address;

	pg_address = 0xB0;
	for (page_cnt=0;page_cnt<8;page_cnt++)
	{

		Lcd_Byte_Wr(pg_address,1); 


		Lcd_Byte_Wr(0x10,1);


		Lcd_Byte_Wr(0x01,1);

		for (col_cnt=0;col_cnt<128;col_cnt++)
		{
			Lcd_Byte_Wr(corp_pic[page_cnt*128 + col_cnt],0);
		}

		pg_address ++;
	}
	
	Delayus(1000);
}

void PrintASCII(unsigned char x,unsigned char y,unsigned char *pstr)
{
    unsigned int addr;
    unsigned char j,n;
    
    
      addr=*pstr++;
      addr=(addr-1)*32;
      for(n=0;n<4;n++)
      {
        Lcd_Byte_Wr(y|0xb0,1);
        Lcd_Byte_Wr((x>>4)|0x10,1);
        Lcd_Byte_Wr(x&0x0f,1);
        //Lcd_Byte_Wr(0x01,1);
        for(j=0;j<8;j++)
        {
            Lcd_Byte_Wr(pstr[j+8*n],0);
        }
        y = y+1;
      }
      y=y-2;
      x=x+8;    
}


void PrintGB(unsigned char x,unsigned char y,unsigned char *pstr)
{
    unsigned int addr;
    unsigned char j,n;
    
    
      addr=*pstr++;
      addr=(addr-1)*32;
      for(n=0;n<2;n++)
      {
        Lcd_Byte_Wr(y|0xb0,1);
        Lcd_Byte_Wr((x>>4)|0x10,1);
        Lcd_Byte_Wr(x&0x0f,1);
        //Lcd_Byte_Wr(0x01,1);
        for(j=0;j<16;j++)
        {
            Lcd_Byte_Wr(pstr[j+16*n],0);
        }
        y = y+1;
      }
      y=y-2;
      x=x+16;    
}

void ClearlcdRAM(void) 
{
    unsigned char i,j;
    
    for(i=0;i<8;i++)
    {   
        //WDTCTL = WDT_ARST_250;;
        Lcd_Byte_Wr(i|0xb0,1);
        Lcd_Byte_Wr(0x10,1);
        Lcd_Byte_Wr(0x00,1);
        for(j=0;j<132;j++)
        {
          Lcd_Byte_Wr(0x00,0);
        }
    }
}






