/*--------------------------------------------------------------------------
File Name:12864R5.C;
Description:This Resouce Is For Dot Matrix Liquid Crystal 
            Modules Controlled By Sitronix'S ST7565R

Author By:XIAHANG
Date:20080605
--------------------------------------------------------------------------*/


#include <reg51.h>
#include <INTRINS.H>


#define  uchar unsigned char
#define  uint unsigned int
#define  uchar_code unsigned char code

#define DELAYMS 	100
#define DataPort 	



uchar_code border_inf[8] = {
	0x00,0x00,0x00,0x80,0x01,0x00,0x00,0x00 };


uchar_code corp_pic[] = {
/*--  调入了一幅图像：E:\2008设计项目\Test Programs\lcm_取模图片\12864（福瑞博）.bmp  --*/
/*--  宽度x高度=128x64  --*/
0xFF,0x00,0x00,0x00,0x00,0x00,0x00,0x00,0x00,0x00,0x00,0x00,0x00,0x00,0x00,0x00,
0x00,0x00,0x00,0x00,0x00,0x00,0x00,0x00,0x00,0x00,0x00,0x00,0x00,0x00,0x00,0x00,
0x00,0x00,0x00,0x00,0x00,0x00,0x00,0x00,0x00,0x00,0x00,0x00,0x00,0x00,0x00,0x00,
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0x00,0x00,0x01,0x00,0x00,0x00,0x00,0x00,0x00,0x00,0x00,0x00,0x00,0x00,0x00,0xFF,

};


#pragma disable
void delay(uint dlyms)
{
	uint ui_dlay1;
	for (ui_dlay1=0; ui_dlay1<dlyms; ui_dlay1++);
}


#pragma disable
void delayms()
{
	uint ui_dlay1,ui_dlay2;
	ui_dlay2 = DELAYMS;
	while (ui_dlay2-- >0)
		for (ui_dlay1=0; ui_dlay1<500; ui_dlay1++){};
}


#pragma disable
void Func_int0() interrupt 0 using 1
{
	if (ui_pause == 0)
 		ui_pause = 1;
	else
		ui_pause = 0;


	if ( ui_pause == 1 )
		while (1)
		{
			if (PAUSE == 0)
				return;
		}
}


	 /*
#pragma disable
void wr_dat(uchar uc_dat)
{
	
	DataPort = uc_dat;
	P_CS1 = 0;
	P_E   = 0;
	P_RS  = 1;
	P_RW  = 0;
	P_E   = 1;
	_nop_();
	_nop_();
	P_E = 0;
	P_CS1 = 1;
  delay(10);
}


#pragma disable
void wr_cmd(uchar cmd)
{
	
	DataPort = cmd;
	P_CS1 = 0;
	P_E   = 0;
	P_RS  = 0;
	P_RW  = 0;
	P_E   = 1;
	_nop_();
	_nop_();
	P_E = 0;
	P_CS1 = 1;
  delay(10);	
 
}

	*/

//----------------------------spi ----------------//
void wr_cmd(uchar cmd)
{
 uchar k;

P_CS1 = 0;
P_RS = 0;

 for (k=0; k<8; k++)
 {
 cmd = cmd<<1;
 SCL = 0;
 SDA = CY;
 SCL = 1;
 }

P_CS1=1;
}
//----------------------------writedata------------------//
void wr_dat(uchar dat)
{
 uchar k;

P_CS1 = 0;
P_RS = 1;

 for (k=0; k<8; k++)
 {
 dat = dat<<1;
 SDA = CY;
 SCL = 0;
 SCL = 1;
 }

P_CS1=1;
}

#pragma disable
void Initial()
{

	wr_cmd(0xA0);//set seg direct	  A0=seg0→131    /	 A1=seg131→0
	
	wr_cmd(0xC0);//set com direct	C0=COM0→COM63	 / 	 C1=COM63→COM0
	
	wr_cmd(0xA2);//set lcd bias
	
        wr_cmd(0x24);//set internal rb/ra

	wr_cmd(0x2F);//all power on

	wr_cmd(0x81);//set contrast
	wr_cmd(52);
	
	wr_cmd(0xAF);//dispaly on
	

}

#pragma disable
void disp_dat(uchar uc_dat1,uchar uc_dat2,uint Is_Twice)
{
	uint page_cnt,col_cnt;
	uchar pg_address;

	pg_address = 0xB0;

	for (page_cnt=0;page_cnt<8;page_cnt++)
	{
	
		wr_cmd(pg_address); 

	
		wr_cmd(0x10);


		wr_cmd(0x01);
		for (col_cnt=0;col_cnt<32;col_cnt++)
		{
			if (Is_Twice == 0)
			{
				wr_dat(uc_dat1);	//   delayms();
				wr_dat(uc_dat2);	//  delayms();
				wr_dat(uc_dat1);	//  delayms();
				wr_dat(uc_dat2);	//  delayms();//delayms();delayms();
			}
			else
			{
				wr_dat(uc_dat1);
				wr_dat(uc_dat1);
				wr_dat(uc_dat2);
				wr_dat(uc_dat2);
			}
		}
			 //delayms();delayms();
		pg_address ++;
	}
	delayms();
}

#pragma disable
void disp_border()
{
	uint page_cnt,col_cnt;
	uchar pg_address;

	pg_address = 0xB0;

	for (page_cnt=0;page_cnt<8;page_cnt++)
	{
	
		wr_cmd(pg_address); 


		wr_cmd(0x10);

	
		wr_cmd(0x01);

		wr_dat(0xFF);
		
		for (col_cnt=0;col_cnt<126;col_cnt++)
		{
			wr_dat(border_inf[page_cnt]);
		}

		wr_dat(0xFF);

		pg_address ++;
	
	}
	delayms();
}
			
#pragma disable
void disp_bmp(uchar_code *bmparea)
{
	uint page_cnt,col_cnt;
	uchar pg_address;

	pg_address = 0xB0;
	for (page_cnt=0;page_cnt<8;page_cnt++)
	{

		wr_cmd(pg_address); 


		wr_cmd(0x10);


		wr_cmd(0x01);

		for (col_cnt=0;col_cnt<128;col_cnt++)
		{
			wr_dat(bmparea[page_cnt*128 + col_cnt]);
		}

		pg_address ++;
	}
	
	delayms();
}
/*	
void disp_bmp(uchar_code *bmparea)
{
	uint page_cnt,col_cnt;
	uchar pg_address;

	pg_address = 0xB7;
	for (page_cnt=7;page_cnt>0;page_cnt--)
	{

		wr_cmd(pg_address); 


		wr_cmd(0x10);


		wr_cmd(0x01);

		for (col_cnt=0;col_cnt<128;col_cnt++)
		{
			wr_dat(bmparea[page_cnt*128 + col_cnt]);
		}

		pg_address --;
	}
	
	delayms();
}	*/
void main()
{

		
//	EA=1; 

//	IT0 = 1;

//	EX0 = 1;


	_nop_();
	_nop_();

	//P_CS2 = 1;
//	_nop_();
//	_nop_();

	P_RST=0;
	delay(250);
	delay(250);
	delay(250);
	delay(250);
	P_RST=1;
	delay(250);
	delay(250);

	Initial();
	   disp_dat(0x00,0x00,1);
	while(1)
	{

		   	disp_dat(0xFF,0xFF,0);
		  	disp_border();


		disp_bmp(corp_pic);
		
	
	//	disp_border();

	 
		disp_dat(0x55,0x55,0);
		

		disp_dat(0xAA,0xAA,1);


	//	disp_dat(0x33,0x33,1);


	//	disp_dat(0xFF,0x00,1);


//		disp_dat(0x00,0xFF,1);


	//	disp_dat(0xFF,0x00,1);


		disp_dat(0x55,0xAA,0);


		disp_dat(0xAA,0x55,0);

		
		
	
		
	};
 }













